/*
 * RockChip. DisplayPort screen LP097QX1
 *
 */

		disp_timings: display-timings {
                        native-mode = <&lp097qx1>;
                        lp097qx1: timing0 {
				screen-type = <SCREEN_EDP>;
				out-face    = <OUT_P666>;				
				clock-frequency = <138500000>;
				hactive = <1920>;
				vactive = <1080>;
				hback-porch = <10>;
				hfront-porch = <150>;
				vback-porch = <11>;
				vfront-porch = <20>;
				hsync-len = <32>;
				vsync-len = <5>;
				hsync-active = <0>;
				vsync-active = <0>;
				de-active = <0>;
				pixelclk-active = <1>;
				swap-rb = <0>;
				swap-rg = <0>;
				swap-gb = <0>;
                     	};
               };
